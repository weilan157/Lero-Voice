## Lero-Voice/components/diag/Kconfig
```kconfig
menu "Lero Voice Diagnostics"

config LERO_DIAG_CONSOLE
    bool "Enable UART console REPL (CN2, docs/PLAN.md 3.8)"
    default y

config LERO_DIAG_SD_LOG
    bool "Mirror logs to SD (/logs, rotating)"
    default y

config LERO_DIAG_LOG_FILE_SIZE_KB
    int "SD log file size limit (KB)"
    default 256

config LERO_DIAG_LOG_FILES
    int "SD log file count (ring)"
    default 4

config LERO_DIAG_SNAPSHOT_PERIOD_MS
    int "Snapshot sampling period (ms)"
    default 1000

config LERO_DIAG_SNAPSHOT_SLOTS
    int "Snapshot ring slot count"
    default 32

config LERO_DIAG_TASK_PRIORITY
    int "diag_task priority (lowest, docs/PLAN.md 3.5.1)"
    default 1
    range 1 18

config LERO_DIAG_TASK_STACK_SIZE
    int "diag_task stack size (bytes)"
    default 4096

config LERO_DIAG_TASK_CORE
    int "diag_task core"
    default 0
    range 0 1

endmenu
```

## Lero-Voice/components/ota_service/Kconfig
```kconfig
menu "Lero Voice OTA Service"

config LERO_OTA_HTTP_META_URL
    string "HTTP OTA meta.json URL (GitHub latest direct link)"
    default "https://github.com/your-username/Lero-Voice/releases/latest/download/meta.json"

config LERO_OTA_TARGET
    string "Expected hardware target in meta.json"
    default "esp32s31-wroom-3"

config LERO_OTA_SOC
    string "Expected SoC in meta.json"
    default "esp32s31"

config LERO_OTA_BATTERY_THRESHOLD_PCT
    int "Refuse download/switch below this battery level (%)"
    default 20

config LERO_OTA_CONFIRM_TIMEOUT_MS
    int "User confirm timeout (ms); default 'later' keeps pending"
    default 60000

config LERO_OTA_REBOOT_COUNTDOWN_MS
    int "Reboot countdown after confirm (ms)"
    default 3000

config LERO_OTA_FLASH_SIZE
    int "Expected flash size (bytes, meta.json flash_size check)"
    default 16777216

config LERO_OTA_HTTP_TIMEOUT_MS
    int "HTTP download timeout (ms)"
    default 30000

config LERO_OTA_SD_UPDATE_DIR
    string "SD update directory"
    default "/sdcard/update"

config LERO_OTA_CHUNK_SIZE
    int "OTA write chunk size (bytes)"
    default 4096

endmenu
```

## Lero-Voice/main/Kconfig
```kconfig
menu "Lero Voice Application"

config LERO_NET_TASK_PRIORITY
    int "net_task priority"
    default 6
    range 1 18

config LERO_NET_TASK_STACK_SIZE
    int "net_task stack size (bytes)"
    default 6144

config LERO_NET_TASK_CORE
    int "net_task core (0=PRO_CPU, 1=APP_CPU)"
    default 0
    range 0 1

config LERO_NET_POLL_PERIOD_MS
    int "net_task poll period (ms)"
    default 5000

config LERO_OTA_TASK_PRIORITY
    int "ota_task priority"
    default 5
    range 1 18

config LERO_OTA_TASK_STACK_SIZE
    int "ota_task stack size (bytes)"
    default 6144

config LERO_OTA_TASK_CORE
    int "ota_task core"
    default 0
    range 0 1

config LERO_OTA_CHECK_INTERVAL_MS
    int "ota_task periodic check interval (ms)"
    default 3600000

config LERO_SYS_TASK_PRIORITY
    int "system_task priority"
    default 2
    range 1 18

config LERO_SYS_TASK_STACK_SIZE
    int "system_task stack size (bytes)"
    default 4096

config LERO_SYS_TASK_CORE
    int "system_task core"
    default 0
    range 0 1

config LERO_APP_EVENT_QUEUE_LEN
    int "app event queue length"
    default 16

endmenu
```

## components/bt_audio/Kconfig
```kconfig
menu "Lero Voice Bluetooth Audio (A2DP sink)"

config LERO_BT_AUDIO_ENABLE
    bool "Enable Bluetooth Classic A2DP music playback"
    default y
    help
        Stream music from a phone over BT Classic A2DP to the ES8389
        (S31 supports BT Classic; Bluedroid decodes SBC, PCM goes to the
        shared codec). Requires CONFIG_BT_ENABLED / Bluedroid / A2DP.

endmenu
```

## components/player/Kconfig
```kconfig
menu "Lero Voice Audio Player"

config LERO_PLAYER_TASK_PRIORITY
    int "Player internal task priority (ESP-GMF asp task)"
    default 5
    range 1 18

config LERO_PLAYER_TASK_STACK
    int "Player internal task stack (bytes)"
    default 6144

config LERO_PLAYER_CTRL_TASK_PRIORITY
    int "Player control task priority (loop replay)"
    default 3
    range 1 18

config LERO_PLAYER_CTRL_TASK_STACK
    int "Player control task stack (bytes)"
    default 2048

config LERO_PLAYER_CTRL_TASK_CORE
    int "Player control task core (0=PRO_CPU, 1=APP_CPU)"
    default 1
    range 0 1

config LERO_PLAYER_DEFAULT_VOLUME
    int "Default playback volume (0-100)"
    default 60
    range 0 100

config LERO_PLAYER_DL_TASK_PRIORITY
    int "URL download task priority"
    default 8
    range 1 18

config LERO_PLAYER_DL_TASK_STACK
    int "URL download task stack (bytes)"
    default 6144

config LERO_PLAYER_DL_TASK_CORE
    int "URL download task core (0=PRO_CPU, 1=APP_CPU)"
    default 0
    range 0 1

config LERO_PLAYER_DL_URL_MAX
    int "Max download URL length (bytes)"
    default 256

config LERO_PLAYER_DL_TIMEOUT_MS
    int "HTTP download timeout (ms)"
    default 15000

config LERO_PLAYER_DL_BUFFER
    int "HTTP download buffer size (bytes)"
    default 2048

config LERO_PLAYER_DL_DIR
    string "Download directory on SD card"
    default "/sdcard/download"

endmenu
```

## components/provisioning/Kconfig
```kconfig
menu "Lero Voice Provisioning"

config LERO_PROV_WIFI_CONNECT_TIMEOUT_MS
    int "Saved-config connect timeout (ms)"
    default 15000

config LERO_PROV_SMARTCONFIG_TIMEOUT_MS
    int "SmartConfig listen timeout (ms)"
    default 60000

config LERO_PROV_AP_TIMEOUT_MS
    int "softAP fallback idle timeout (ms)"
    default 180000

config LERO_PROV_PROBE_URL
    string "Network probe URL (must be reachable on the 2.4G network)"
    default "http://www.msftconnecttest.com/connecttest.txt"

config LERO_PROV_PROBE_TIMEOUT_MS
    int "Network probe timeout (ms)"
    default 5000

config LERO_PROV_AP_SSID_PREFIX
    string "softAP SSID prefix"
    default "LeroVoice-"

config LERO_PROV_PROBE_MAX_RETRIES
    int "Network probe retries before softAP fallback"
    default 3

endmenu
```

## components/ui/Kconfig
```kconfig
menu "Lero Voice UI"

config LERO_UI_TASK_STACK
    int "LVGL task stack (bytes)"
    default 8192

config LERO_UI_TASK_PRIORITY
    int "LVGL task priority"
    default 6
    range 1 18

config LERO_UI_TASK_CORE
    int "LVGL task core (-1 = no affinity)"
    default -1
    range -1 1

config LERO_UI_DEMO_BENCHMARK
    bool "Run LVGL official benchmark demo on boot (FPS)"
    default y

endmenu
```

## components/voice/Kconfig
```kconfig
menu "Lero Voice Voice Assistant"

config LERO_VOICE_TASK_PRIORITY
    int "voice_task priority"
    default 15
    range 1 18

config LERO_VOICE_TASK_STACK
    int "voice_task stack (bytes)"
    default 12288

config LERO_VOICE_TASK_CORE
    int "voice_task core (0=PRO_CPU, 1=APP_CPU)"
    default 1
    range 0 1

config LERO_VOICE_SAMPLE_RATE
    int "Capture sample rate (Hz; must match player/codec clock domain)"
    default 48000

config LERO_VOICE_CHANNELS
    int "Capture channels (2 = dual mic)"
    default 2
    range 1 2

config LERO_VOICE_FRAME_MS
    int "Capture frame length (ms)"
    default 20

config LERO_VOICE_LISTEN_TIMEOUT_MS
    int "Max listen duration (ms)"
    default 10000

config LERO_VOICE_VAD_RMS_THRESHOLD
    int "VAD RMS threshold (16-bit PCM; higher = less sensitive)"
    default 400

config LERO_VOICE_VAD_TAIL_MS
    int "VAD tail after last speech (ms)"
    default 800

config LERO_VOICE_MIN_UTTERANCE_MS
    int "Minimum utterance length before auto stop (ms)"
    default 400

config LERO_VOICE_RECORD_DEFAULT_SECONDS
    int "Default record duration (s, console 'rec')"
    default 30
    range 1 600

config LERO_VOICE_RECORD_MEM_BUF_KB
    int "In-RAM record buffer size (KB, static PSRAM; 'rec' without SD)"
    default 6144
    range 512 12288
    help
        Static buffer used when recording without an SD card (console "rec"
        with no path). 6 MB holds ~31 s at 48 kHz / 2 ch / 16 bit
        (192000 B/s). Placed in PSRAM via SPIRAM_ALLOW_BSS_SEG_EXTERNAL_MEMORY.

config LERO_VOICE_RECORD_DEFAULT_PATH
    string "Default record output path (WAV on SD)"
    default "/sdcard/record/rec.wav"

endmenu
```
